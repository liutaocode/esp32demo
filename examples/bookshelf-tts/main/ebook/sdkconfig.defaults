## examples/bookshelf-tts/main/ebook/sdkconfig.defaults
```kconfig
# main/apps/ebook/sdkconfig.defaults —— 只在 FAP_APP=ebook 时追加。
# 其余应用不挂载 books 分区,也就不必为长文件名和 HTTP 服务付出代码体积。
# --- FATFS(电子书 books 分区)---
# 阅读器要保存用户上传的中文书名,因此打开长文件名与 UTF-8 文件名 API。
# 长文件名缓冲放在堆上,避免为一个可选应用固定占用静态内存。
CONFIG_FATFS_LFN_HEAP=y
CONFIG_FATFS_MAX_LFN=64
CONFIG_FATFS_API_ENCODING_UTF_8=y

# --- HTTP 服务(电子书 Wi-Fi 传书)---
# 上传按块流式落盘,单块 2 KB;头部放宽到 1 KB 以容纳长文件名查询串。
CONFIG_HTTPD_MAX_REQ_HDR_LEN=1024
CONFIG_HTTPD_MAX_URI_LEN=512
```
